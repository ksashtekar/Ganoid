## Kconfig
```kconfig
source kernel/Kconfig

config TEST_DIR
       string
       prompt "Path to test directory"
       help
		Enter the path to your test directory. The test directory
		should contain the disk image.


config ENABLE_ACPI
       bool
       prompt "Enable ACPI"
       help
		ACPI is not functional now. This switch is to be enabled only
		for ACPI development


source mm/Kconfig
```

## kernel/Kconfig
```kconfig
config MAX_CREATE_THREADS
       int
       prompt "Max threads"
       default 10
       help
	This is the maximum threads that can be created in the lifetime of
        the system.
```

## mm/Kconfig
```kconfig
config PAGE_ALLOC_DEBUG
       bool "Enable debug for page alloc"
       default n
       help
	Enable debug prints
```
